## conf/bblayers.conf
```bitbake
# POKY_BBLAYERS_CONF_VERSION is increased each time build/conf/bblayers.conf
# changes incompatibly
POKY_BBLAYERS_CONF_VERSION = "2"

BBPATH = "${TOPDIR}"
BBFILES ?= ""

BBLAYERS ?= " \
  /home/nils/repos/yocto/poky/meta \
  /home/nils/repos/yocto/poky/meta-poky \
  /home/nils/repos/yocto/poky/meta-yocto-bsp \
  "
```
